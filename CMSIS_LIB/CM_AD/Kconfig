## CMSIS_LIB/CM_AD/Kconfig
```kconfig
#
# Copyright (c) 2018 Nordic Semiconductor
#
# SPDX-License-Identifier: LicenseRef-BSD-5-Clause-Nordic
#

source "Kconfig.zephyr"

menu "Nordic UART BLE GATT service sample"
endmenu
```

## TINY_ImageClassifier/build_TINY/Kconfig/Kconfig.shield
```kconfig
osource "c:/MasterThesis_Nrf/nRF53_TEST/boards/shields/*/Kconfig.shield"
osource "C:/Users/sigur/ncs/v1.8.0/nrf/boards/shields/*/Kconfig.shield"
```

## TINY_ImageClassifier/build_TINY/Kconfig/Kconfig.shield.defconfig
```kconfig
osource "c:/MasterThesis_Nrf/nRF53_TEST/boards/shields/*/Kconfig.defconfig"
osource "C:/Users/sigur/ncs/v1.8.0/nrf/boards/shields/*/Kconfig.defconfig"
```

## TINY_ImageClassifier/build_nRF53/Kconfig/Kconfig.shield
```kconfig
osource "c:/gthubTest/Master/caf/boards/shields/*/Kconfig.shield"
osource "C:/Users/sigur/ncs/v1.8.0/nrf/boards/shields/*/Kconfig.shield"
```

## TINY_ImageClassifier/build_nRF53/Kconfig/Kconfig.shield.defconfig
```kconfig
osource "c:/CMSIS_Acc/CMSIS_TEST/boards/shields/*/Kconfig.defconfig"
osource "c:/CMSIS_Acc/v2/firmware-nrf52840-5340/boards/shields/*/Kconfig.defconfig"
osource "c:/CMSIS_Acc/CMTEST/boards/shields/*/Kconfig.defconfig"
osource "c:/CMSIS_Acc/CM_AD/boards/shields/*/Kconfig.defconfig"
osource "c:/CMSIS_Acc/CM_IC/boards/shields/*/Kconfig.defconfig"
osource "c:/CMSIS_Acc/CM_KWS/boards/shields/*/Kconfig.defconfig"
osource "c:/CMSIS_Acc/CM_VWW/boards/shields/*/Kconfig.defconfig"
osource "c:/gthubTest/Master/caf/boards/shields/*/Kconfig.defconfig"
osource "C:/Users/sigur/ncs/v1.8.0/nrf/boards/shields/*/Kconfig.defconfig"
```

## TINY_VisualWakeWords/build_f/Kconfig/Kconfig.shield
```kconfig
osource "c:/CMSIS_Acc/CM_VWW/boards/shields/*/Kconfig.shield"
osource "c:/CMSIS_Acc/CM_AD/boards/shields/*/Kconfig.shield"
osource "c:/CMSIS_Acc/CM_IC/boards/shields/*/Kconfig.shield"
osource "c:/CMSIS_Acc/CM_KWS/boards/shields/*/Kconfig.shield"
osource "c:/MasterThesis_Nrf/peripheral_lbs/boards/shields/*/Kconfig.shield"
osource "C:/Users/sigur/ncs/v1.8.0/nrf/boards/shields/*/Kconfig.shield"
```

## TINY_VisualWakeWords/build_f/Kconfig/Kconfig.shield.defconfig
```kconfig
osource "c:/CMSIS_Acc/CM_VWW/boards/shields/*/Kconfig.defconfig"
osource "c:/CMSIS_Acc/CM_AD/boards/shields/*/Kconfig.defconfig"
osource "c:/CMSIS_Acc/CM_IC/boards/shields/*/Kconfig.defconfig"
osource "c:/CMSIS_Acc/CM_KWS/boards/shields/*/Kconfig.defconfig"
osource "c:/MasterThesis_Nrf/peripheral_lbs/boards/shields/*/Kconfig.defconfig"
osource "C:/Users/sigur/ncs/v1.8.0/nrf/boards/shields/*/Kconfig.defconfig"
```

## TINY_VisualWakeWords/build_nRF53/Kconfig/Kconfig.shield
```kconfig
osource "c:/CMSIS_Acc/CMSIS_TEST/boards/shields/*/Kconfig.shield"
osource "c:/CMSIS_Acc/v2/firmware-nrf52840-5340/boards/shields/*/Kconfig.shield"
osource "c:/CMSIS_Acc/CMTEST/boards/shields/*/Kconfig.shield"
osource "c:/CMSIS_Acc/CM_AD/boards/shields/*/Kconfig.shield"
osource "c:/CMSIS_Acc/CM_IC/boards/shields/*/Kconfig.shield"
osource "c:/CMSIS_Acc/CM_KWS/boards/shields/*/Kconfig.shield"
osource "c:/CMSIS_Acc/CM_VWW/boards/shields/*/Kconfig.shield"
osource "C:/Users/sigur/ncs/v1.8.0/nrf/boards/shields/*/Kconfig.shield"
```
